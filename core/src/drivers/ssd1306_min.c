#include "ssd1306_min.h"
#include <string.h>

static uint8_t SSD1306_Buffer[SSD1306_WIDTH * SSD1306_HEIGHT / 8];

static void SSD1306_WriteCommand(I2C_HandleTypeDef *hi2c, uint8_t cmd) {
    uint8_t payload[2] = {0x00, cmd};
    HAL_I2C_Master_Transmit(hi2c, SSD1306_ADDR, payload, 2, 10);
}

void SSD1306_Init(I2C_HandleTypeDef *hi2c) {
    HAL_Delay(100);
    uint8_t init_cmds[] = {
        0xAE, 0x20, 0x00, 0xB0, 0xC8, 0x00, 0x10, 0x40,
        0x81, 0x7F, 0xA1, 0xA6, 0xA8, 0x3F, 0xA4, 0xD3,
        0x00, 0xD5, 0x80, 0xD9, 0xF1, 0xDA, 0x12, 0xDB,
        0x40, 0x8D, 0x14, 0xAF
    };
    for(uint8_t i = 0; i < sizeof(init_cmds); i++) {
        SSD1306_WriteCommand(hi2c, init_cmds[i]);
    }
    SSD1306_Clear();
    SSD1306_UpdateScreen(hi2c);
}

void SSD1306_Clear(void) {
    memset(SSD1306_Buffer, 0x00, sizeof(SSD1306_Buffer));
}

void SSD1306_UpdateScreen(I2C_HandleTypeDef *hi2c) {
    for (uint8_t page = 0; page < 8; page++) {
        SSD1306_WriteCommand(hi2c, 0xB0 + page);
        SSD1306_WriteCommand(hi2c, 0x00);
        SSD1306_WriteCommand(hi2c, 0x10);

        uint8_t chunk[SSD1306_WIDTH + 1];
        chunk[0] = 0x40; // Control byte for Data
        memcpy(&chunk[1], &SSD1306_Buffer[page * SSD1306_WIDTH], SSD1306_WIDTH);
        HAL_I2C_Master_Transmit(hi2c, SSD1306_ADDR, chunk, sizeof(chunk), 20);
    }
}

void SSD1306_DrawPixel(int16_t x, int16_t y, uint8_t color) {
    if (x < 0 || x >= SSD1306_WIDTH || y < 0 || y >= SSD1306_HEIGHT) return;
    if (color) SSD1306_Buffer[x + (y / 8) * SSD1306_WIDTH] |= (1 << (y % 8));
    else       SSD1306_Buffer[x + (y / 8) * SSD1306_WIDTH] &= ~(1 << (y % 8));
}

void SSD1306_DrawFastHLine(int16_t x, int16_t y, int16_t w) {
    for (int16_t i = x; i < x + w; i++) SSD1306_DrawPixel(i, y, 1);
}

void SSD1306_DrawBitmap(int16_t x, int16_t y, const uint8_t *bitmap, int16_t w, int16_t h) {
    int16_t byteWidth = (w + 7) / 8;
    for (int16_t j = 0; j < h; j++) {
        for (int16_t i = 0; i < w; i++) {
            if (bitmap[j * byteWidth + (i / 8)] & (128 >> (i % 8))) {
                SSD1306_DrawPixel(x + i, y + j, 1);
            }
        }
    }
}

// Standard ASCII 5x7 font (Adafruit glcdfont.c), chars 0x20-0x7E.
// 5 bytes per glyph = 5 columns; bit N of a column = pixel row N (bit0 = top).
static const uint8_t FONT5X7[95][5] = {
    {0x00, 0x00, 0x00, 0x00, 0x00},  /* 0x20   */
    {0x00, 0x00, 0x5F, 0x00, 0x00},  /* 0x21 ! */
    {0x00, 0x07, 0x00, 0x07, 0x00},  /* 0x22 " */
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    {0x02, 0x01, 0x02, 0x04, 0x02},  /* 0x7E ~ */
};

static const uint8_t* SSD1306_GetGlyph(char c) {
    static const uint8_t blank[5] = {0x00,0x00,0x00,0x00,0x00};
    if (c < 0x20 || c > 0x7E) return blank;
    return FONT5X7[(unsigned char)c - 0x20];
}

void SSD1306_DrawChar(int16_t x, int16_t y, char c, uint8_t scale) {
    const uint8_t *glyph = SSD1306_GetGlyph(c);
    for (int8_t col = 0; col < 5; col++) {
        uint8_t line = glyph[col];
        for (int8_t row = 0; row < 7; row++) {
            if (line & (1 << row)) {
                for (uint8_t sx = 0; sx < scale; sx++) {
                    for (uint8_t sy = 0; sy < scale; sy++) {
                        SSD1306_DrawPixel(x + col * scale + sx, y + row * scale + sy, 1);
                    }
                }
            }
        }
    }
}

void SSD1306_DrawString(int16_t x, int16_t y, const char *str, uint8_t scale) {
    int16_t cursor = x;
    while (*str) {
        SSD1306_DrawChar(cursor, y, *str, scale);
        cursor += 6 * scale; // 5px glyph + 1px spacing
        str++;
    }
}